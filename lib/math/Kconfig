## lib/math/Kconfig
```kconfig
# SPDX-License-Identifier: GPL-2.0-only
config CORDIC
	tristate "CORDIC algorithm"
	help
	  This option provides an implementation of the CORDIC algorithm;
	  calculations are in fixed point. Module will be called cordic.

config PRIME_NUMBERS
	tristate "Simple prime number generator for testing"
	help
	  This option provides a simple prime number generator for test
	  modules.

	  If unsure, say N.

config RATIONAL
	tristate

config STATS
       tristate "fast integer statistics module"
       help
	 This option provides functions for calculating mean and standard
      	 deviation, both standard and expotentially weighted variants"

config STATS_UNIT_TEST
       tristate "statitics unit tests" if !KUNIT_ALL_TESTS
       depends on STATS && KUNIT
       default KUNIT_ALL_TESTS
```
